## dect_nrplus/Kconfig.dect_cvg
```kconfig
# /* lib/dect_nrplus/Kconfig.dect_cvg */ 
# Copyright (c) 2023 Nordic Semiconductor ASA
# SPDX-License-Identifier: LicenseRef-Nordic-5-Clause

menuconfig DECT_CVG_LAYER
	bool "DECT NR+ CVG Layer Support"
	default y if DECT_DLC_LAYER
	depends on DECT_DLC_LAYER
	# help
	#   Enable the DECT NR+ Convergence (CVG) layer.
	#   This layer is responsible for end-to-end services like
	#   segmentation/reassembly, flow control, and ARQ.
	#   It sits between the application/L2 and the DLC layer.

if DECT_CVG_LAYER

config DECT_CVG_TX_THREAD_STACK_SIZE
	int "CVG TX thread stack size"
	default 2048
	# help
	#   Stack size for the CVG layer's TX thread. This thread
	#   takes data from the application, builds CVG PDUs, and
	#   passes them to the DLC layer.

config DECT_CVG_TX_THREAD_PRIORITY
	int "CVG TX thread priority"
	default 5
	# help
	#   Priority for the CVG TX thread.

config DECT_CVG_RX_THREAD_STACK_SIZE
	int "CVG RX thread stack size"
	default 2048
	# help
	#   Stack size for the CVG layer's RX thread. This thread
	#   receives data from the DLC layer, performs reassembly,
	#   and passes complete SDUs up to the application.

config DECT_CVG_RX_THREAD_PRIORITY
	int "CVG RX thread priority"
	default 5
	# help
	#   Priority for the CVG RX thread.

config DECT_CVG_TX_SERVICE_THREAD_STACK_SIZE
	int "CVG TX service thread stack size"
	default 2048
	# help
	#   Stack size for the CVG layer's TX service thread, which
	#   handles background tasks like ARQ retransmissions.

config DECT_CVG_TX_SERVICE_THREAD_PRIORITY
	int "CVG TX service thread priority"
	default 5
	# help
	#   Priority for the CVG TX service thread.

config DECT_CVG_LOG_LEVEL
	int "DECT NR+ CVG layer log level"
	default 3
	range 0 4
	depends on LOG
	# help
	#   Log level for the DECT NR+ CVG layer.

endif # DECT_CVG_LAYER
```

## dect_nrplus/tests/advanced_mac/testcase.yaml
```yaml
tests:
  testing.dect_nrplus.mac.advanced:
    tags: dect_nrplus mac sm advanced
    platform_allow: native_posix
```

## dect_nrplus/tests/cdd_service/testcase.yaml
```yaml
tests:
  testing.dect_nrplus.cdd.service:
    tags: dect_nrplus cdd cvg
    platform_allow: native_posix
    integration_platforms:
      - native_posix
```

## dect_nrplus/tests/dlc_sar/testcase.yaml
```yaml
tests:
  testing.dect_nrplus.dlc.sar:
    tags: dect_nrplus dlc sar
    platform_allow: native_posix
    integration_platforms:
      - native_posix
```

## dect_nrplus/tests/mac_association/testcase.yaml
```yaml
tests:
  testing.dect_nrplus.mac.association:
    tags: dect_nrplus mac sm
    platform_allow: native_posix
    integration_platforms:
      - native_posix
```

## dect_nrplus/tests/mac_pdu/test_assoc_ies/testcase.yaml
```yaml
tests:
  testing.dect_nrplus.mac.pdu.assoc_ies:
    tags: dect_nrplus mac pdu
    platform_allow: native_posix
    integration_platforms:
      - native_posix
```

## dect_nrplus/tests/mac_pdu/test_security/testcase.yaml
```yaml
tests:
  testing.dect_nrplus.mac.pdu.security:
    tags: dect_nrplus mac security crypto
    platform_allow: native_posix
    integration_platforms:
      - native_posix
```
