## prj.conf
```kconfig
/* lib/dect_nrplus/tests/advanced_mac/prj.conf */
/* This is a new file. It provides the Kconfig options for the advanced MAC procedures test suite. */

CONFIG_ZTEST=y
CONFIG_LOG=y
CONFIG_DECT_MAC_LAYER=y
CONFIG_DECT_MAC_FT_SUPPORTS_GROUP_ASSIGNMENT=y
CONFIG_DECT_MAC_LOG_LEVEL_DBG=y
```

## src/main.c
```c
/* lib/dect_nrplus/tests/advanced_mac/src/main.c */
/* This is a new file. It contains a Ztest suite for verifying advanced MAC procedures like Reconfiguration and Group Assignment scheduling. */
--- NEW FILE ---
#include <zephyr/kernel.h>
#include <zephyr/ztest.h>
#include "dect_mac_context.h"
#include "dect_mac_sm_ft.h"

LOG_MODULE_REGISTER(test_advanced_mac, LOG_LEVEL_DBG);

/* Mocks and Fixture setup would be similar to test_mac_flow.c */
ZTEST(advanced_mac_tests, test_reconfiguration_flow)
{
	/* TODO: Implement test for Reconfiguration Request/Response */
	ztest_test_skip();
}

ZTEST(advanced_mac_tests, test_group_assignment_scheduling)
{
	/* TODO: Implement test to verify PT listens on group-scheduled slot */
	ztest_test_skip();
}

ZTEST_SUITE(advanced_mac_tests, NULL, NULL, NULL, NULL, NULL);
```
